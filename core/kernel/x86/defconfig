## user/bootloaders/rsw/Kconfig
```kconfig
config STACK_SIZE
       int "Stack size (KB)"
       default "8"

config STAND_ALONE
       bool "Stand-alone version"
       default no

config CONTAINER_AT_FIXED_ADDR
       bool "Load container at a fixed address"
       default y

source "../../../core/Kconfig.ver"
```

## user/bootloaders/rsw/sparcv8/Kconfig
```kconfig
mainmenu "RSW Configuration"

source "Kconfig"

menu "RSW memory layout"

config CONTAINER_ADDR
       hex "Container physical location address"
#       default "0x4000"
       default "0x40300000"
       depends on STAND_ALONE||CONTAINER_AT_FIXED_ADDR

config RDONLY_SEC_ADDR
       hex "Read-only section addresses"
       default "0x40280000"
       #default "0x400000"

config RW_SEC_ADDR
       hex "Read/write section addresses"
       default "0x40290000"
       #default "0x600000"

endmenu

config OUTPUT_ENABLED
       bool "Enable RSW output"
       default n

config CPU_FREQ_AUTO
       bool "Autodetect CPU frequency"
       default y

config CPU_KHZ
       int "CPU frequency (KHz)"
       default "50000"
       #default "45000"
       depends on OUTPUT_ENABLED&&!CPU_FREQ_AUTO

choice
	prompt "Enable UART support"
	default UART1
        depends on OUTPUT_ENABLED

config UART1
       bool "UART1"
config UART2
       bool "UART2"

endchoice

config UART_BAUDRATE
       int "UART baud rate"
       default "115200"
       depends on OUTPUT_ENABLED
```
